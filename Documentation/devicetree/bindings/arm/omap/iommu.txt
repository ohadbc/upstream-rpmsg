## Documentation/devicetree/bindings/arm/omap/iommu.txt
```
* MMU (Memory Management Unit)

MMU present in OMAP subsystems.

Required properties:
 compatible : should be "ti,omap3-iommu" for OMAP3 MMUs
 compatible : should be "ti,omap4-iommu" for OMAP4 MMUs

Optional properties:
 None
```

## drivers/amp/Kconfig
```kconfig
#
# AMP subsystem configuration
#

menu "Asymmetric Multiprocessing (AMP) Framework"

source "drivers/amp/remoteproc/Kconfig"

endmenu
```

## drivers/amp/rpmsg/Kconfig
```kconfig
# RPMSG always gets selected by whoever wants it
config RPMSG
	tristate
	select VIRTIO
	select VIRTIO_RING

config RPMSG_SERVER_SAMPLE
	tristate "An rpmsg server sample"
	depends on RPMSG
	---help---
	  This is just a sample server driver for the rpmsg bus.
	  Say either Y or M. You know you want to.
```

## drivers/remoteproc/Kconfig
```kconfig
#
# Generic framework for controlling remote processors
#

# REMOTE_PROC gets selected by whoever wants it
config REMOTE_PROC
	tristate
```

## drivers/rpmsg/Kconfig
```kconfig
# RPMSG always gets selected by whoever wants it
config RPMSG
	tristate
	select VIRTIO
	select VIRTIO_RING

source "drivers/rpmsg/host/Kconfig"
```
